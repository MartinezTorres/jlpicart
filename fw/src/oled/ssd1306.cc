#include <board.h>
#include "ssd1306.h"

namespace I2C {

    namespace Private {

        static void sda_high() { gpio_set_dir( GPIO64_OLEDSDA, GPIO_IN ); };
        static void sda_low()  { gpio_set_dir( GPIO64_OLEDSDA, GPIO_OUT ); };
        static void scl_high() { gpio_set_dir( GPIO64_OLEDSCK, GPIO_IN ); };
        static void scl_low()  { gpio_set_dir( GPIO64_OLEDSCK, GPIO_OUT ); };

        static void init() {

            gpio_init(GPIO64_OLEDSCK); 
            gpio_set_drive_strength(GPIO64_OLEDSCK, GPIO_DRIVE_STRENGTH_8MA);
            gpio_set_slew_rate(GPIO64_OLEDSCK, GPIO_SLEW_RATE_FAST);
            gpio_put(GPIO64_OLEDSCK, false);
            scl_high();
            
            gpio_init(GPIO64_OLEDSDA);
            gpio_set_drive_strength(GPIO64_OLEDSDA, GPIO_DRIVE_STRENGTH_8MA);
            gpio_set_slew_rate(GPIO64_OLEDSDA, GPIO_SLEW_RATE_FAST);
            gpio_put(GPIO64_OLEDSDA, false);
            sda_high();
        }

        static void start() {

            busy_wait_us_32(4);
            sda_low();
            busy_wait_us_32(4);
            scl_low();
            busy_wait_us_32(4);
        }

        static int send_byte(uint8_t data) {

            for(uint8_t i=0; i<8; i++) {

                if (data & 0x80) {
                    sda_high();
                } else {
                    sda_low();
                }
                data <<= 1;

                busy_wait_us_32(1);
                scl_high();
                busy_wait_us_32(1);
                scl_low();
                busy_wait_us_32(1);
            }
            sda_high();
            busy_wait_us_32(1);
            scl_high();
            busy_wait_us_32(1);
            scl_low();
            busy_wait_us_32(1);
            return 0;
        }

        static void stop() {
            sda_low();
            busy_wait_us_32(4);
            scl_high();
            busy_wait_us_32(4);
            sda_high();
        }
        
        static int write(uint8_t address, const uint8_t *src, size_t len) {

            //auto interrupt_status = save_and_disable_interrupts();

            start();
            if (send_byte(address+address)) return -1;
            

            while (len--) 
                if ( send_byte(*src++) ) return -1;
            
            stop();

            //restore_interrupts(interrupt_status);
            
            return false;
        }

    }

    inline void init() { Private::init(); }

    inline bool write(uint8_t address, const uint8_t *src, size_t len) { return Private::write(address, src, len); }
}


// The SSD1306 is an OLED/PLED driver chip, capable of driving displays up to
// 128x64 pixels.

namespace SSD1306 {

    enum Size { HEIGHT = 32, WIDTH = 128 };

    namespace Private {

        static constexpr uint8_t font[256][8] = {
            {0x00, 0x00, 0x00, 0x00, 0x00, 0x00, 0x00, 0x00}, //0
            {0x3C, 0x42, 0xA5, 0xA5, 0xC3, 0xBD, 0x42, 0x3C}, //1
            {0x3C, 0x7E, 0xDB, 0xDB, 0xBD, 0xC3, 0x7E, 0x3C}, //2
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            {0xAA, 0x55, 0xAA, 0x55, 0xAA, 0x55, 0xAA, 0x55}, //255
        };

        enum Commands {

            SET_MEM_MODE        = 0x20,
            SET_COL_ADDR        = 0x21,
            SET_PAGE_ADDR       = 0x22,
            SET_HORIZ_SCROLL    = 0x26,
            SET_SCROLL          = 0x2E,

            SET_DISP_START_LINE = 0x40,

            SET_CONTRAST        = 0x81,
            SET_CHARGE_PUMP     = 0x8D,

            SET_SEG_REMAP       = 0xA0,
            SET_ENTIRE_ON       = 0xA4,
            SET_ALL_ON          = 0xA5,
            SET_NORM_DISP       = 0xA6,
            SET_INV_DISP        = 0xA7,
            SET_MUX_RATIO       = 0xA8,
            SET_DISP            = 0xAE,
            SET_COM_OUT_DIR     = 0xC0,
            SET_COM_OUT_DIR_FLIP = 0xC8,

            SET_DISP_OFFSET     = 0xD3,
            SET_DISP_CLK_DIV    = 0xD5,
            SET_PRECHARGE       = 0xD9,
            SET_COM_PIN_CFG     = 0xDA,
            SET_VCOM_DESEL      = 0xDB,
        };

        static constexpr uint8_t I2C_ADDR = 0x3C+0;

        //static constexpr uint8_t PAGE_HEIGHT = 8;
        //static constexpr uint8_t NUM_PAGES = HEIGHT / PAGE_HEIGHT;
        //static constexpr uint8_t BUF_LEN =(NUM_PAGES * WIDTH);

        //enum Mode { WRITE_MODE = 0xFE, READ_MODE = 0xFF };


        static void send_cmd(uint8_t cmd) {
            // I2C write process expects a control byte followed by data
            // this "data" can be a command or data to follow up a command
            // Co = 1, D/C = 0 => the driver expects a command
            uint8_t buf[2] = {0x80, cmd};
            I2C::write(I2C_ADDR, buf, 2);

        }

        static void write_data(uint8_t *buf, size_t len) {
            I2C::write(I2C_ADDR, buf, len);
        }

        static void init() {

            I2C::init();

            uint8_t cmds[] = {

                SET_DISP | 0x00,        // set display off

                SET_MEM_MODE,           // set memory address mode 0 = horizontal, 1 = vertical, 2 = page
                0x00,                           // horizontal addressing mode

                SET_DISP_START_LINE,    // set display start line to 0
                //SET_SEG_REMAP | 0x01,   // set segment re-map, column address 127 is mapped to SEG0

                SET_MUX_RATIO,          // set multiplex ratio
                HEIGHT - 1,             // Display height - 1

                //SET_COM_OUT_DIR | 0x08, // set COM (common) output scan direction. Scan from bottom up, COM[N-1] to COM0

                SET_DISP_OFFSET,        // set display offset
                0x00,                           // no offset

                SET_COM_PIN_CFG,        // set COM (common) pins hardware configuration. Board specific magic number.
                                        // 0x02 Works for 128x32, 0x12 Possibly works for 128x64. Other options 0x22, 0x32
                (HEIGHT == 32? 0x02 : 0x12),


                SET_DISP_CLK_DIV,       // set display clock divide ratio
                0x80,                           // div ratio of 1, standard freq
                SET_PRECHARGE,          // set pre-charge period
                0xF1,                           // Vcc internally generated on our board
                SET_VCOM_DESEL,         // set VCOMH deselect level
                0x30,                           // 0.83xVcc

                SET_CONTRAST,           // set contrast control
                0xFF,
                SET_ENTIRE_ON,          // set entire display on to follow RAM content
                SET_NORM_DISP,           // set normal (not inverted) display
                SET_CHARGE_PUMP,        // set charge pump
                0x14,                           // Vcc internally generated on our board
                SET_SCROLL | 0x00,      // deactivate horizontal scrolling if set. This is necessary as memory writes will corrupt if scrolling was enabled
                SET_DISP | 0x01,        // turn display on
            };
            
            for (auto &cmd : cmds)
                Private::send_cmd(cmd);

            SSD1306::locate(0,0);
            for (int i=0; i<16*4; i++)
                SSD1306::putchar(' ');
            SSD1306::locate(0,0);


        }
    }

    void init() { Private::init(); }

    void enable_display(bool on) {
        Private::send_cmd( Private::SET_DISP | uint8_t(on) );
    }

    void set_display_start_line(uint8_t line) {
        Private::send_cmd(Private::SET_DISP_START_LINE | ( line & 0x3F) );
    }

    void putchar(uint8_t idx) {

        uint8_t buf[9];
        buf[0] = 0x40;

        for (int i=0; i<8; i++) {
            buf[i+1] = 0;
            for (int j=0; j<8; j++) {
                buf[i+1] |= (int(!!( Private::font[idx][j] & (1<<(7-i)) )) << j); 
            }
        }

        Private::write_data(buf, 9);
    }

    void locate(uint8_t x, uint8_t y) {

        uint8_t cmds[] = {
            Private::SET_COL_ADDR,
            uint8_t(x<<3),
            WIDTH-1,
            Private::SET_PAGE_ADDR,
            y,
            HEIGHT-1,
        };

        for (auto &cmd : cmds)
            Private::send_cmd(cmd);

    }

    void set_invert(bool invert) {
        Private::send_cmd( invert ? Private::SET_INV_DISP : Private::SET_NORM_DISP );
    }

    void puts(const char *str) {
        while (*str) 
            SSD1306::putchar(*str++);
    }
}

